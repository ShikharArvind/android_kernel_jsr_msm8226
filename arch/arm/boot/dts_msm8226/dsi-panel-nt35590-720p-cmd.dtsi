/* Copyright (c) 2013-2014, The Linux Foundation. All rights reserved.
 *
 * This program is free software; you can redistribute it and/or modify
 * it under the terms of the GNU General Public License version 2 and
 * only version 2 as published by the Free Software Foundation.
 *
 * This program is distributed in the hope that it will be useful,
 * but WITHOUT ANY WARRANTY; without even the implied warranty of
 * MERCHANTABILITY or FITNESS FOR A PARTICULAR PURPOSE.  See the
 * GNU General Public License for more details.
 */

/*---------------------------------------------------------------------------
 * This file is autogenerated file using gcdb parser. Please do not edit it.
 * Update input XML file to add a new entry or update variable in this file
 * VERSION = "1.0"
 *---------------------------------------------------------------------------*/
&mdss_mdp {
	dsi_nt35590_720_cmd: qcom,mdss_dsi_720p_cmd {
		qcom,mdss-dsi-panel-name = "nt35590 720p command mode dsi panel";
		qcom,mdss-dsi-panel-controller = <&mdss_dsi0>;
		qcom,mdss-dsi-panel-type = "dsi_cmd_mode";
		qcom,mdss-dsi-panel-destination = "display_1";
		qcom,mdss-dsi-panel-framerate = <60>;

		qcom,mdss-dsi-panel-id0-gpio = <8 4 0>;
		qcom,mdss-dsi-panel-id1-gpio = <8 5 0>;

		qcom,mdss-dsi-virtual-channel-id = <0>;
		qcom,mdss-dsi-stream = <0>;
		qcom,mdss-dsi-panel-width = <720>;
		qcom,mdss-dsi-panel-height = <1280>;
		qcom,mdss-dsi-h-front-porch = <140>;
		qcom,mdss-dsi-h-back-porch = <164>;
		qcom,mdss-dsi-h-pulse-width = <8>;
		qcom,mdss-dsi-h-sync-skew = <0>;
		qcom,mdss-dsi-v-back-porch = <1>;
		qcom,mdss-dsi-v-front-porch = <6>;
		qcom,mdss-dsi-v-pulse-width = <1>;
		qcom,mdss-dsi-h-left-border = <0>;
		qcom,mdss-dsi-h-right-border = <0>;
		qcom,mdss-dsi-v-top-border = <0>;
		qcom,mdss-dsi-v-bottom-border = <0>;
		qcom,mdss-dsi-bpp = <24>;
		qcom,mdss-dsi-underflow-color = <0xff>;
		qcom,mdss-dsi-border-color = <0>;
		qcom,mdss-dsi-on-command = <0x29010000 0x2ff 0xee290100 0x2 0x26082901 0x0 0x2260029 0x1000010 0x2ff00 0x29010000 0x100002ff 0xee290100 0x2 0xfb012901 0x0 0x2125029 0x1000000 0x21302 0x29010000 0x26a 0x60290100 0x2 0xff002901 0x0 0x2ba0329 0x1000000 0x2c208 0x29010000 0x2ff 0x1290100 0x2 0x3a2901 0x0 0x2013329 0x1000000 0x20253 0x29010000 0x209 0x85290100 0x2 0xe252901 0x0 0x20f0a29 0x1000000 0x20b97 0x29010000 0x20c 0x97290100 0x2 0x118a2901 0x0 0x2367b29 0x1000000 0x2712c 0x29010000 0x2ff 0x5290100 0x2 0x1002901 0x0 0x2028d29 0x1000000 0x2038d 0x29010000 0x204 0x8d290100 0x2 0x5302901 0x0 0x2063329 0x1000000 0x20777 0x29010000 0x208 0x290100 0x2 0x9002901 0x0 0x20a0029 0x1000000 0x20b80 0x29010000 0x20c 0xc8290100 0x2 0xd002901 0x0 0x20e1b29 0x1000000 0x20f07 0x29010000 0x210 0x57290100 0x2 0x11002901 0x0 0x2120029 0x1000000 0x2131e 0x29010000 0x214 0x290100 0x2 0x151a2901 0x0 0x2160529 0x1000000 0x21700 0x29010000 0x218 0x1e290100 0x2 0x19ff2901 0x0 0x21a0029 0x1000000 0x21bfc 0x29010000 0x21c 0x80290100 0x2 0x1d002901 0x0 0x21e1029 0x1000000 0x21f77 0x29010000 0x220 0x290100 0x2 0x21002901 0x0 0x2225529 0x1000000 0x2230d 0x29010000 0x231 0xa0290100 0x2 0x32002901 0x0 0x233b829 0x1000000 0x234bb 0x29010000 0x235 0x11290100 0x2 0x36012901 0x0 0x2370b29 0x1000000 0x23801 0x29010000 0x239 0xb290100 0x2 0x44082901 0x0 0x2458029 0x1000000 0x246cc 0x29010000 0x247 0x4290100 0x2 0x48002901 0x0 0x2490029 0x1000000 0x24a01 0x29010000 0x26c 0x3290100 0x2 0x6d032901 0x0 0x26e2f29 0x1000000 0x24300 0x29010000 0x24b 0x23290100 0x2 0x4c012901 0x0 0x2502329 0x1000000 0x25101 0x29010000 0x258 0x23290100 0x2 0x59012901 0x0 0x25d2329 0x1000000 0x25e01 0x29010000 0x262 0x23290100 0x2 0x63012901 0x0 0x2672329 0x1000000 0x26801 0x29010000 0x289 0x290100 0x2 0x8d012901 0x0 0x28e6429 0x1000000 0x28f20 0x29010000 0x297 0x8e290100 0x2 0x828c2901 0x0 0x2830229 0x1000000 0x2bb0a 0x29010000 0x2bc 0xa290100 0x2 0x24252901 0x0 0x2255529 0x1000000 0x22605 0x29010000 0x227 0x23290100 0x2 0x28012901 0x0 0x2293129 0x1000000 0x22a5d 0x29010000 0x22b 0x1290100 0x2 0x2f002901 0x0 0x2301029 0x1000000 0x2a712 0x29010000 0x22d 0x3290100 0x2 0xff012901 0x0 0x2750029 0x1000000 0x27642 0x29010000 0x277 0x290100 0x2 0x78512901 0x0 0x2790029 0x1000000 0x27a6b 0x29010000 0x27b 0x290100 0x2 0x7c812901 0x0 0x27d0029 0x1000000 0x27e94 0x29010000 0x27f 0x290100 0x2 0x80a52901 0x0 0x2810029 0x1000000 0x282b3 0x29010000 0x283 0x290100 0x2 0x84c12901 0x0 0x2850029 0x1000000 0x286cd 0x29010000 0x287 0x290100 0x2 0x88f92901 0x0 0x2890129 0x1000000 0x28a1f 0x29010000 0x28b 0x1290100 0x2 0x8c592901 0x0 0x28d0129 0x1000000 0x28e85 0x29010000 0x28f 0x1290100 0x2 0x90d12901 0x0 0x2910229 0x1000000 0x2920c 0x29010000 0x293 0x2290100 0x2 0x940e2901 0x0 0x2950229 0x1000000 0x29644 0x29010000 0x297 0x2290100 0x2 0x98802901 0x0 0x2990229 0x1000000 0x29aa6 0x29010000 0x29b 0x2290100 0x2 0x9cd32901 0x0 0x29d0229 0x1000000 0x29ef4 0x29010000 0x29f 0x3290100 0x2 0xa01e2901 0x0 0x2a20329 0x1000000 0x2a329 0x29010000 0x2a4 0x3290100 0x2 0xa5362901 0x0 0x2a60329 0x1000000 0x2a744 0x29010000 0x2a9 0x3290100 0x2 0xaa572901 0x0 0x2ab0329 0x1000000 0x2ac68 0x29010000 0x2ad 0x3290100 0x2 0xae7a2901 0x0 0x2af0329 0x1000000 0x2b089 0x29010000 0x2b1 0x3290100 0x2 0xb2952901 0x0 0x2b30029 0x1000000 0x2b442 0x29010000 0x2b5 0x290100 0x2 0xb6512901 0x0 0x2b70029 0x1000000 0x2b86b 0x29010000 0x2b9 0x290100 0x2 0xba812901 0x0 0x2bb0029 0x1000000 0x2bc94 0x29010000 0x2bd 0x290100 0x2 0xbea52901 0x0 0x2bf0029 0x1000000 0x2c0b3 0x29010000 0x2c1 0x290100 0x2 0xc2c12901 0x0 0x2c30029 0x1000000 0x2c4cd 0x29010000 0x2c5 0x290100 0x2 0xc6f92901 0x0 0x2c70129 0x1000000 0x2c81f 0x29010000 0x2c9 0x1290100 0x2 0xca592901 0x0 0x2cb0129 0x1000000 0x2cc85 0x29010000 0x2cd 0x1290100 0x2 0xced12901 0x0 0x2cf0229 0x1000000 0x2d00c 0x29010000 0x2d1 0x2290100 0x2 0xd20e2901 0x0 0x2d30229 0x1000000 0x2d444 0x29010000 0x2d5 0x2290100 0x2 0xd6802901 0x0 0x2d70229 0x1000000 0x2d8a6 0x29010000 0x2d9 0x2290100 0x2 0xdad32901 0x0 0x2db0229 0x1000000 0x2dcf4 0x29010000 0x2dd 0x3290100 0x2 0xde1e2901 0x0 0x2df0329 0x1000000 0x2e029 0x29010000 0x2e1 0x3290100 0x2 0xe2362901 0x0 0x2e30329 0x1000000 0x2e444 0x29010000 0x2e5 0x3290100 0x2 0xe6572901 0x0 0x2e70329 0x1000000 0x2e868 0x29010000 0x2e9 0x3290100 0x2 0xea7a2901 0x0 0x2eb0329 0x1000000 0x2ec89 0x29010000 0x2ed 0x3290100 0x2 0xee952901 0x0 0x2ef0029 0x1000000 0x2f042 0x29010000 0x2f1 0x290100 0x2 0xf2512901 0x0 0x2f30029 0x1000000 0x2f46b 0x29010000 0x2f5 0x290100 0x2 0xf6812901 0x0 0x2f70029 0x1000000 0x2f894 0x29010000 0x2f9 0x290100 0x2 0xfaa52901 0x0 0x2ff0229 0x1000000 0x20000 0x29010000 0x201 0xb3290100 0x2 0x2002901 0x0 0x203c129 0x1000000 0x20400 0x29010000 0x205 0xcd290100 0x2 0x6002901 0x0 0x207f929 0x1000000 0x20801 0x29010000 0x209 0x1f290100 0x2 0xa012901 0x0 0x20b5929 0x1000000 0x20c01 0x29010000 0x20d 0x85290100 0x2 0xe012901 0x0 0x20fd129 0x1000000 0x21002 0x29010000 0x211 0xc290100 0x2 0x12022901 0x0 0x2130e29 0x1000000 0x21402 0x29010000 0x215 0x44290100 0x2 0x16022901 0x0 0x2178029 0x1000000 0x21802 0x29010000 0x219 0xa6290100 0x2 0x1a022901 0x0 0x21bd329 0x1000000 0x21c02 0x29010000 0x21d 0xf4290100 0x2 0x1e032901 0x0 0x21f1e29 0x1000000 0x22003 0x29010000 0x221 0x29290100 0x2 0x22032901 0x0 0x2233629 0x1000000 0x22403 0x29010000 0x225 0x44290100 0x2 0x26032901 0x0 0x2275729 0x1000000 0x22803 0x29010000 0x229 0x68290100 0x2 0x2a032901 0x0 0x22b7a29 0x1000000 0x22d03 0x29010000 0x22f 0x89290100 0x2 0x30032901 0x0 0x2319529 0x1000000 0x23200 0x29010000 0x233 0x42290100 0x2 0x34002901 0x0 0x2355129 0x1000000 0x23600 0x29010000 0x237 0x6b290100 0x2 0x38002901 0x0 0x2398129 0x1000000 0x23a00 0x29010000 0x23b 0x94290100 0x2 0x3d002901 0x0 0x23fa529 0x1000000 0x24000 0x29010000 0x241 0xb3290100 0x2 0x42002901 0x0 0x243c129 0x1000000 0x24400 0x29010000 0x245 0xcd290100 0x2 0x46002901 0x0 0x247f929 0x1000000 0x24801 0x29010000 0x249 0x1f290100 0x2 0x4a012901 0x0 0x24b5929 0x1000000 0x24c01 0x29010000 0x24d 0x85290100 0x2 0x4e012901 0x0 0x24fd129 0x1000000 0x25002 0x29010000 0x251 0xc290100 0x2 0x52022901 0x0 0x2530e29 0x1000000 0x25402 0x29010000 0x255 0x44290100 0x2 0x56022901 0x0 0x2588029 0x1000000 0x25902 0x29010000 0x25a 0xa6290100 0x2 0x5b022901 0x0 0x25cd329 0x1000000 0x25d02 0x29010000 0x25e 0xf4290100 0x2 0x5f032901 0x0 0x2601e29 0x1000000 0x26103 0x29010000 0x262 0x29290100 0x2 0x63032901 0x0 0x2643629 0x1000000 0x26503 0x29010000 0x266 0x44290100 0x2 0x67032901 0x0 0x2685729 0x1000000 0x26903 0x29010000 0x26a 0x68290100 0x2 0x6b032901 0x0 0x26c7a29 0x1000000 0x26d03 0x29010000 0x26e 0x89290100 0x2 0x6f032901 0x0 0x2709529 0x1000000 0x27100 0x29010000 0x272 0x42290100 0x2 0x73002901 0x0 0x2745129 0x1000000 0x27500 0x29010000 0x276 0x6b290100 0x2 0x77002901 0x0 0x2788129 0x1000000 0x27900 0x29010000 0x27a 0x94290100 0x2 0x7b002901 0x0 0x27ca529 0x1000000 0x27d00 0x29010000 0x27e 0xb3290100 0x2 0x7f002901 0x0 0x280c129 0x1000000 0x28100 0x29010000 0x282 0xcd290100 0x2 0x83002901 0x0 0x284f929 0x1000000 0x28501 0x29010000 0x286 0x1f290100 0x2 0x87012901 0x0 0x2885929 0x1000000 0x28901 0x29010000 0x28a 0x85290100 0x2 0x8b012901 0x0 0x28cd129 0x1000000 0x28d02 0x29010000 0x28e 0xc290100 0x2 0x8f022901 0x0 0x2900e29 0x1000000 0x29102 0x29010000 0x292 0x44290100 0x2 0x93022901 0x0 0x2948029 0x1000000 0x29502 0x29010000 0x296 0xa6290100 0x2 0x97022901 0x0 0x298d329 0x1000000 0x29902 0x29010000 0x29a 0xf4290100 0x2 0x9b032901 0x0 0x29c1e29 0x1000000 0x29d03 0x29010000 0x29e 0x29290100 0x2 0x9f032901 0x0 0x2a03629 0x1000000 0x2a203 0x29010000 0x2a3 0x44290100 0x2 0xa4032901 0x0 0x2a55729 0x1000000 0x2a603 0x29010000 0x2a7 0x68290100 0x2 0xa9032901 0x0 0x2aa7a29 0x1000000 0x2ab03 0x29010000 0x2ac 0x89290100 0x2 0xad032901 0x0 0x2ae9529 0x1000000 0x2af00 0x29010000 0x2b0 0x42290100 0x2 0xb1002901 0x0 0x2b25129 0x1000000 0x2b300 0x29010000 0x2b4 0x6b290100 0x2 0xb5002901 0x0 0x2b68129 0x1000000 0x2b700 0x29010000 0x2b8 0x94290100 0x2 0xb9002901 0x0 0x2baa529 0x1000000 0x2bb00 0x29010000 0x2bc 0xb3290100 0x2 0xbd002901 0x0 0x2bec129 0x1000000 0x2bf00 0x29010000 0x2c0 0xcd290100 0x2 0xc1002901 0x0 0x2c2f929 0x1000000 0x2c301 0x29010000 0x2c4 0x1f290100 0x2 0xc5012901 0x0 0x2c65929 0x1000000 0x2c701 0x29010000 0x2c8 0x85290100 0x2 0xc9012901 0x0 0x2cad129 0x1000000 0x2cb02 0x29010000 0x2cc 0xc290100 0x2 0xcd022901 0x0 0x2ce0e29 0x1000000 0x2cf02 0x29010000 0x2d0 0x44290100 0x2 0xd1022901 0x0 0x2d28029 0x1000000 0x2d302 0x29010000 0x2d4 0xa6290100 0x2 0xd5022901 0x0 0x2d6d329 0x1000000 0x2d702 0x29010000 0x2d8 0xf4290100 0x2 0xd9032901 0x0 0x2da1e29 0x1000000 0x2db03 0x29010000 0x2dc 0x29290100 0x2 0xdd032901 0x0 0x2de3629 0x1000000 0x2df03 0x29010000 0x2e0 0x44290100 0x2 0xe1032901 0x0 0x2e25729 0x1000000 0x2e303 0x29010000 0x2e4 0x68290100 0x2 0xe5032901 0x0 0x2e67a29 0x1000000 0x2e703 0x29010000 0x2e8 0x89290100 0x2 0xe9032901 0x0 0x2ea9529 0x1000000 0x2ff00 0x29010000 0x2fb 0x1290100 0x2 0xff012901 0x0 0x2fb0129 0x1000000 0x2ff02 0x29010000 0x2fb 0x1290100 0x2 0xff032901 0x0 0x2fb0129 0x1000000 0x2ff04 0x29010000 0x2fb 0x1290100 0x2 0xff052901 0x0 0x2fb0129 0x1000000 0x2ff00 0x29010000 0x78000211 0x290100 0x2 0x51ff2901 0x0 0x2532c29 0x1000000 0x25500 0x29010000 0x229 0x290100 0x2 0xff002901 0x1400 0x2350029 0x1000078 0x2532c>;
		qcom,mdss-dsi-off-command = [05 01 00 00 32 00 02 28 00
					05 01 00 00 78 00 02 10 00];
		qcom,mdss-dsi-on-command-state = "dsi_lp_mode";
		qcom,mdss-dsi-off-command-state = "dsi_hs_mode";
		qcom,mdss-dsi-h-sync-pulse = <1>;
		qcom,mdss-dsi-traffic-mode = "burst_mode";
		qcom,mdss-dsi-bllp-eof-power-mode;
		qcom,mdss-dsi-bllp-power-mode;
		qcom,mdss-dsi-lane-0-state;
		qcom,mdss-dsi-lane-1-state;
		qcom,mdss-dsi-lane-2-state;
		qcom,mdss-dsi-lane-3-state;
		qcom,mdss-dsi-te-pin-select = <1>;
		qcom,mdss-dsi-wr-mem-start = <0x2c>;
		qcom,mdss-dsi-te-dcs-command = <1>;
		qcom,mdss-dsi-te-check-enable;
		qcom,mdss-dsi-te-using-te-pin;
		qcom,mdss-dsi-panel-timings = [7d 25 1d 00 37 33 22 27 1e 03 04 00];
		qcom,mdss-dsi-t-clk-post = <0x20>;
		qcom,mdss-dsi-t-clk-pre = <0x2c>;
		qcom,mdss-dsi-bl-min-level = <1>;
		qcom,mdss-dsi-bl-max-level = <165>;
		qcom,mdss-dsi-dma-trigger = "trigger_sw";
		qcom,mdss-dsi-mdp-trigger = "none";
		qcom,mdss-dsi-bl-pmic-control-type = "bl_ctrl_dcs";
		qcom,mdss-dsi-reset-sequence = <1 20>, <0 1>, <1 20>;
		/* qcom,mdss-pan-physical-width-dimension = <59>; */
		/* qcom,mdss-pan-physical-height-dimension = <104>; */

	};
};

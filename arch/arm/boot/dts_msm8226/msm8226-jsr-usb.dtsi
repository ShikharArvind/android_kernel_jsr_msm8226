

&usb_otg {
	#address-cells = <0>;
	interrupt-parent = <&usb_otg>;
	interrupts = <0 1 2>;
	#interrupt-cells = <1>;
	interrupt-map-mask = <0xffffffff>;
	interrupt-map = <0 &intc 0 134 0
			1 &intc 0 140 0
			2 &spmi_bus 0x0 0x0 0x9 0x0>;
	interrupt-names = "core_irq", "async_irq", "pmic_id_irq";

	qcom,hsusb-otg-mode = <3>;   /* 3 = OTG mode */
	/delete-property/ qcom,hsusb-otg-disable-reset;  /* If present then core is RESET only during init, otherwise core is RESET for every cable disconnect as well */
	vbus_otg-supply = <&pm8226_chg_otg>;
};
